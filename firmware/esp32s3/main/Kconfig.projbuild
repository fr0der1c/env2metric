## firmware/esp32s3/main/Kconfig.projbuild
```kconfig
menu "env2metric"

config ENV2METRIC_WIFI_SSID
    string "Wi-Fi SSID"
    default ""
    help
        SSID used by the ESP32-S3 firmware in station mode.

config ENV2METRIC_WIFI_PASSWORD
    string "Wi-Fi password"
    default ""
    help
        Password used by the ESP32-S3 firmware in station mode.
        Leave empty only for open networks.

config ENV2METRIC_OTLP_METRICS_URL
    string "OTLP metrics URL"
    default "http://signoz.local:4318/v1/metrics"
    help
        OTLP/HTTP metrics endpoint.

config ENV2METRIC_OTLP_HTTP_TIMEOUT_MS
    int "OTLP HTTP timeout in milliseconds"
    default 5000
    range 1000 60000
    help
        Timeout used when sending metrics to the OTLP endpoint.

config ENV2METRIC_SENSOR_BAUD_RATE
    int "Sensor CDC serial baud rate"
    default 57600
    range 9600 115200
    help
        Baud rate used when configuring the air quality monitor CDC serial line.

config ENV2METRIC_SNTP_SERVER
    string "SNTP server"
    default "pool.ntp.org"
    help
        NTP server used to synchronize system time before exporting OTLP metrics.

config ENV2METRIC_SNTP_TIMEOUT_MS
    int "SNTP sync timeout in milliseconds"
    default 15000
    range 1000 60000
    help
        Maximum time to wait for system time synchronization after Wi-Fi connects.

endmenu
```

## firmware/esp32s3/sdkconfig.defaults
```kconfig
CONFIG_ESPTOOLPY_FLASHSIZE_16MB=y
CONFIG_ESPTOOLPY_FLASHSIZE="16MB"
CONFIG_ESPTOOLPY_MONITOR_BAUD=115200
CONFIG_COMPILER_CXX_EXCEPTIONS=y
CONFIG_ESP_MAIN_TASK_STACK_SIZE=8192
CONFIG_PARTITION_TABLE_SINGLE_APP_LARGE=y
CONFIG_ENV2METRIC_SENSOR_BAUD_RATE=57600
```

## firmware/esp32s3/sdkconfig.defaults.local.example
```kconfig
CONFIG_ENV2METRIC_WIFI_SSID="your-wifi-name"
CONFIG_ENV2METRIC_WIFI_PASSWORD="your-wifi-password"
CONFIG_ENV2METRIC_OTLP_METRICS_URL="https://your-oneuptime-host/otlp/v1/metrics"
CONFIG_ENV2METRIC_OTLP_HEADERS="x-oneuptime-token=your-oneuptime-telemetry-ingestion-key"
```
